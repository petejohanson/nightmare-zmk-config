## config/boards/shields/nightmare/Kconfig.defconfig
```kconfig
# Copyright (c) 2020 The ZMK Contributors
# SPDX-License-Identifier: MIT

if SHIELD_NIGHTMARE

config ZMK_KEYBOARD_NAME
    default "Nightmare"

endif
```

## config/boards/shields/nightmare/Kconfig.shield
```kconfig
# Copyright (c) 2020 The ZMK Contributors
# SPDX-License-Identifier: MIT

config SHIELD_NIGHTMARE
    def_bool $(shields_list_contains,nightmare)
```
